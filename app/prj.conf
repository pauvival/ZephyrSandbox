## CMakeLists.txt
```
# SPDX-License-Identifier: Apache-2.0

cmake_minimum_required(VERSION 3.20.0)

find_package(Zephyr REQUIRED HINTS $ENV{ZEPHYR_BASE})
project(ZephyrSandbox/app)

target_include_directories(app PRIVATE inc)
target_sources(app PRIVATE src/main.c)
target_sources(app PRIVATE src/bluetooth_mg.c)
target_sources(app PRIVATE src/led_driver.c)
```

## prj.conf
```kconfig
#GPIO SUPPORT
CONFIG_GPIO=y

#LOG SUPPORT

CONFIG_LOG=y
CONFIG_LOG_MODE_MINIMAL=y

# Floating Point Unit
CONFIG_FPU=y

# Increase stack size for the main thread and System Workqueue
CONFIG_SYSTEM_WORKQUEUE_STACK_SIZE=2048
CONFIG_MAIN_STACK_SIZE=2048

#---------------------------------------------------------------------------------------------------------------
#BLE stack

#Enable
#By default broadcast support is enabled, BT_LL_CHOICE = BT_LL_SOFTDEVICE, BT_CTLR_TX_PWR = BT_CTLR_TX_PWR_0
#Zephyr automatically handles the finding of the radio HW from the dtsi
CONFIG_BT=y

#Enable security management protocol
CONFIG_BT_SMP=y
CONFIG_BT_BONDABLE=y

#Device name
CONFIG_BT_DEVICE_NAME="ZEPHYR SANDBOX"

#Support for peripheral role
#Enable functionalities for peripheral role, including GATT and ATT
#Default number for simultaneous connections is 1
CONFIG_BT_PERIPHERAL=y


#Change prefered connection parameters 
CONFIG_BT_GAP_AUTO_UPDATE_CONN_PARAMS=y
CONFIG_BT_PERIPHERAL_PREF_MIN_INT=800
CONFIG_BT_PERIPHERAL_PREF_MAX_INT=800
CONFIG_BT_PERIPHERAL_PREF_LATENCY=0
CONFIG_BT_PERIPHERAL_PREF_TIMEOUT=400

#Enable GATT server
CONFIG_BT_GATT_DM=y 

#---------------------------------------------------------------------------------------------------------------
```

## src/main.c
```c
//ZEPHYR SANDBOX

//main.c 

//Generic libraries
#include <stdio.h>
#include <stdint.h>
#include <zephyr/kernel.h>
#include <zephyr/logging/log.h>

//User-made libraries
#include "bluetooth_mg.h"
#include "led_driver.h"
//1000 msec = 1 sec
#define SLEEP_TIME_MS   25


#define STACKSIZE 1024
#define THREAD0_PRIORITY 7
#define THREAD1_PRIORITY 7

LOG_MODULE_REGISTER(app,LOG_LEVEL_DBG);


void offload_led_control(struct k_work *work_term)
{

	LOG_INF("I am offload_led_control()\n");
	if(gatt_led_value == 0)
	{
		leds_reset_all();
	}
	else
	{
		leds_set_all();
	}
}

K_WORK_DEFINE(my_work, offload_led_control);

int main(void)
{
	LOG_INF("Hello World! %s\n", CONFIG_BOARD_TARGET);

	leds_init();
	init_BLE();

	
	while (1) 
	{
		
		k_work_submit(&my_work);
		LOG_INF("LED CONTROL THREAD!\n");
		LOG_INF("Now I have nothing to do :(\n");

		k_msleep(1000);
	}
	
	return 0;
}

int thread0(void){

	while(1)
	{
		LOG_INF("I am thread 0!\n");
		k_msleep(1000);
	}
	
	return 0;

}

int thread1(void){

	while(1)
	{
		LOG_INF("I am thread 1!\n");
		k_msleep(1000);
	}

	return 0;
	
}

K_THREAD_DEFINE(thread0_id, STACKSIZE, thread0, NULL, NULL, NULL,
 THREAD0_PRIORITY, 0, 0);
K_THREAD_DEFINE(thread1_id, STACKSIZE, thread1, NULL, NULL, NULL,
 THREAD1_PRIORITY, 0, 0);
```

## inc/bluetooth_mg.h
```c
//bluetooth_mg
//Management of bluetooth connection 

#ifndef _BLUETOOTH_MANAGEMENT_H_
#define _BLUETOOTH_MANAGEMENT_H_

extern uint16_t gatt_led_value;

void init_BLE( void );
#endif
```

## inc/led_driver.h
```c
//GUIWAY

//hap_driver
//Driver for the haptic actuators (at this stage of development they are LEDS) 

#ifndef _LED_DRIVER_H_
#define _LED_DRIVER_H_

uint32_t leds_init(void);
uint32_t led_set_state(uint32_t index);
void leds_set_all(void);
uint32_t led_reset_state(uint32_t index);
void leds_reset_all(void);
uint32_t led_toggle(uint32_t index);
void leds_toggle_all(void);

#endif
```

## src/bluetooth_mg.c
```c
#include <zephyr/kernel.h>
#include <zephyr/bluetooth/bluetooth.h>
#include <zephyr/bluetooth/conn.h>
#include <zephyr/bluetooth/gap.h>
#include <zephyr/bluetooth/gatt.h>
#include <zephyr/bluetooth/uuid.h>
#include <zephyr/bluetooth/addr.h>
#include <zephyr/logging/log.h>
#include "bluetooth_mg.h"

LOG_MODULE_REGISTER(bluetooth_mg,LOG_LEVEL_DBG);

//BLE

//Obtain BLE device name from prj.conf
#define DEVICE_NAME CONFIG_BT_DEVICE_NAME
#define DEVICE_NAME_LEN (sizeof(DEVICE_NAME) - 1)

//Opaque type representing a connection to a remote device
struct bt_conn *my_conn = NULL;

//A structure used to submit work
//All the members are internal and should not be accessed directly
static struct k_work adv_work;


//----------------------------------------------------------------------------------
//GATT LAYER INFO
//Base UUID                     a743XXXX-0941-4322-8610-858882512683
//Custom LED service            a7431102-0941-4322-8610-858882512683
//LED characteristic            a7431103-0941-4322-8610-858882512683


// Define the Service UUID
#define BT_UUID_LED_SERVICE_VAL     BT_UUID_128_ENCODE(0xa7431102, 0x0941, 0x4322, 0x8610, 0x858882512683)
#define BT_UUID_LED_SERVICE         BT_UUID_DECLARE_128(BT_UUID_LED_SERVICE_VAL)

// Define the Characteristic UUID
#define BT_UUID_LED_CHAR_VAL    BT_UUID_128_ENCODE(0xa7431103, 0x0941, 0x4322, 0x8610, 0x858882512683)
#define BT_UUID_LED_CHAR        BT_UUID_DECLARE_128(BT_UUID_LED_CHAR_VAL)


uint16_t gatt_led_value;

static ssize_t write_led (struct bt_conn *conn, const struct bt_gatt_attr *attr, const void *buf, uint16_t len, uint16_t offset, uint8_t flags)
{
    LOG_INF("Attribute write, handle: %u, conn: %p\n", attr->handle, (void *)conn);

	if (len != sizeof(uint16_t)) {
		LOG_ERR("Write led: Incorrect data length\n");
		return BT_GATT_ERR(BT_ATT_ERR_INVALID_ATTRIBUTE_LEN);
	}

	if (offset != 0) {
		LOG_ERR("Write led: Incorrect data offset\n");
		return BT_GATT_ERR(BT_ATT_ERR_INVALID_OFFSET);
	}

	//Read the received value
    //Assumes central device send data in little-endian format (the standard way)
	uint16_t val = *((uint16_t *)buf);
    gatt_led_value = val;
    LOG_INF("Received value %d", val);

	return len;
}


//Create the custom LED service 
BT_GATT_SERVICE_DEFINE(my_led_svc, 
    BT_GATT_PRIMARY_SERVICE(BT_UUID_LED_SERVICE),
	BT_GATT_CHARACTERISTIC(BT_UUID_LED_CHAR, BT_GATT_CHRC_WRITE,
		BT_GATT_PERM_WRITE_ENCRYPT, NULL, write_led, &gatt_led_value),


);

//--------------------------------------------------------------------------------------
//GAP LAYER
//Struct for advertising packet data
static const struct bt_data ad[] = {
	//Set the advertising flags (no normal Bluetooth supported, connection supported)
	BT_DATA_BYTES(BT_DATA_FLAGS, (BT_LE_AD_GENERAL | BT_LE_AD_NO_BREDR)),

    //Device service UUID (so that python script finds it )
    BT_DATA_BYTES(BT_DATA_UUID128_ALL, BT_UUID_LED_SERVICE_VAL),

};

//Struct for scan response packet data (most probably the scan request will be dropped in the future)
static const struct bt_data sd[] = {
	//Set the device name 
	BT_DATA(BT_DATA_NAME_COMPLETE, DEVICE_NAME, DEVICE_NAME_LEN),
};

//GAP layer events callabacks


//Callback called when a central connects
void connected_cb(struct bt_conn *conn, uint8_t err)
{
    if (err) {
        LOG_ERR("Connection error %d\n", err);
        return;
    }
    LOG_INF("Connected");
    my_conn = bt_conn_ref(conn);

    err = bt_conn_set_security(conn, BT_SECURITY_L2); //request just works security
    if (err) {
        LOG_ERR("Failed to set security (err %d)\n", err);
    }

	struct bt_conn_info info;
	err = bt_conn_get_info(conn, &info);
	if (err) {
		LOG_ERR("bt_conn_get_info() returned %d\n", err);
		return;
	}

	double connection_interval = BT_GAP_US_TO_CONN_INTERVAL(info.le.interval_us) *1.25; // in ms
	uint16_t supervision_timeout = info.le.timeout*10; // in ms
	LOG_INF("Connection parameters: interval %.2f ms, latency %d intervals, timeout %d ms\n", connection_interval, info.le.latency, supervision_timeout);

}

void disconnected_cb(struct bt_conn *conn, uint8_t reason)
{
    LOG_INF("Disconnected. Reason %d\n", reason);
    bt_conn_unref(my_conn);
}

//Handler to resume advertising after a disconnection
static void adv_work_handler(struct k_work *work)
{
	//A custom advertising interval with a parameter could be used instead of BT_LE_ADV_CONN_FAST_1
	int err = bt_le_adv_start(BT_LE_ADV_CONN_FAST_1, ad, ARRAY_SIZE(ad), sd, ARRAY_SIZE(sd));

	if (err) {
		LOG_ERR("Advertising failed to start (err %d)\n", err);
		return;
	}

	LOG_INF("Advertising successfully started\n");
}

//Submit resume advertising work structure to system work queue 
static void advertising_start(void)
{
	k_work_submit(&adv_work);
}

//Callback for when the device is prepared for a new connection
static void recycled_cb(void)
{
	LOG_INF("Connection object available from previous conn. Disconnect is complete!\n");
	advertising_start();
}

//Updated connection parameters callback
void le_param_updated_cb(struct bt_conn *conn, uint16_t interval, uint16_t latency, uint16_t timeout)
{
    double connection_interval = interval*1.25;         // in ms
    uint16_t supervision_timeout = timeout*10;          // in ms
    LOG_INF("Connection parameters updated: interval %.2f ms, latency %d intervals, timeout %d ms\n", connection_interval, latency, supervision_timeout);
}

//Updated PHY parameters callback
void le_phy_updated_cb(struct bt_conn *conn, struct bt_conn_le_phy_info *param)
{
    // PHY Updated
    if (param->tx_phy == BT_CONN_LE_TX_POWER_PHY_1M) {
        LOG_INF("PHY updated. New PHY: 1M\n");
    }
    else if (param->tx_phy == BT_CONN_LE_TX_POWER_PHY_2M) {
        LOG_INF("PHY updated. New PHY: 2M\n");
    }
    else if (param->tx_phy == BT_CONN_LE_TX_POWER_PHY_CODED_S8) {
        LOG_INF("PHY updated. New PHY: Long Range\n");
    }
}

//Updated MTU configuration callback
void le_data_len_updated_cb(struct bt_conn *conn, struct bt_conn_le_data_len_info *info)
{
    uint16_t tx_len     = info->tx_max_len; 
    uint16_t tx_time    = info->tx_max_time;
    uint16_t rx_len     = info->rx_max_len;
    uint16_t rx_time    = info->rx_max_time;
    LOG_INF("Data length updated. Length %d/%d bytes, time %d/%d us\n", tx_len, rx_len, tx_time, rx_time);
}


static void security_changed_cb(struct bt_conn *conn, bt_security_t level, enum bt_security_err err)
{
	char addr[BT_ADDR_LE_STR_LEN];

	bt_addr_le_to_str(bt_conn_get_dst(conn), addr, sizeof(addr));

	if (!err) {
		LOG_INF("Security changed: %s level %u\n", addr, level);
	} else {
		LOG_INF("Security failed: %s level %u err %d\n", addr, level,
			err);
	}
}

BT_CONN_CB_DEFINE(conn_callbacks) = {
	.connected 	= connected_cb,
	.disconnected = disconnected_cb,
	.recycled 	= recycled_cb,
    .le_param_updated   = le_param_updated_cb,
    //.le_phy_updated     = le_phy_updated_cb, //requires prj.conf enables, we will not change it for the time being
    //.le_data_len_updated    = le_data_len_updated_cb, //requires prj.conf enables, we will not change it for the time being
    .security_changed = security_changed_cb,
};

//----------------------------------------------------------------------------------

void init_BLE(void)
{
    int err;

    //Create a random static address
    bt_addr_le_t addr;
    err = bt_addr_le_from_str("FF:EE:DD:CC:BB:AA", "random", &addr);
    if (err) {
        LOG_ERR("Invalid BT address (err %d)\n", err);
    }

    err = bt_id_create(&addr, NULL);
    if (err < 0) {
        LOG_ERR("Creating new ID failed (err %d)\n", err);
    }

	//Enable BLE
	err = bt_enable(NULL);
	if (err) {
		LOG_ERR("Bluetooth init failed (err %d)\n", err);
		return;
	}
	LOG_INF("BLE initialized\n");

	//Start BLE advertising
	//Now it is used through the system workqueue, that way the callback for recycled is reused

    //Associates the handler adv_work_handler with the work structure adv_work 
    //This is only done once unless the associated work handler is to be changed
    //This is done before submiting the work structure first time 
    //This is done at run time. Could be done at compile time with K_WORK_DEFINE. We shall see what fits the project better.
	k_work_init(&adv_work, adv_work_handler);
	advertising_start();

}
```

## src/led_driver.c
```c
#include <zephyr/kernel.h>
#include <zephyr/drivers/gpio.h>
#include <zephyr/logging/log.h>
#include "led_driver.h"

LOG_MODULE_REGISTER(led_driver,LOG_LEVEL_DBG);

//Identify the parent devicetree node
#define LED_NODE DT_PATH(leds)

//Helper macro to initialize each element of the gpio_dt_spec array
#define LED_SPEC_INIT(node_id) GPIO_DT_SPEC_GET(node_id, gpios),

//Build an array of gpio_dt_spec populated from DTS child nodes
static const struct gpio_dt_spec leds[] = {
    DT_FOREACH_CHILD_STATUS_OKAY(LED_NODE, LED_SPEC_INIT)
};

//Obtain the number of LEDS, I do this in order to have flexibility in the future and experiment with dts macros
#define NUM_LEDS DT_CHILD_NUM_STATUS_OKAY(LED_NODE)

/**
 * @brief Initialize all configured LEDs.
 */
uint32_t leds_init(void)
{
    if (NUM_LEDS == 0) {
        LOG_ERR("No LEDs configured in Devicetree.");
        return -ENODEV;
    }

    for (uint32_t i = 0; i < NUM_LEDS; i++) {
        if (!gpio_is_ready_dt(&leds[i])) {
            LOG_ERR("GPIO device %s not ready for LED index %u", 
                    leds[i].port->name, i);
            return -ENODEV;
        }

        uint32_t ret = gpio_pin_configure_dt(&leds[i], GPIO_OUTPUT_INACTIVE);
        if (ret < 0) {
            LOG_ERR("Failed to configure GPIO for LED index %u (err: %d)", i, ret);
            return ret;
        }
    }

    LOG_INF("Successfully initialized %u LEDs", NUM_LEDS);
    return 0;
}

/**
 * @brief Set a specific LED by array index.
 */
uint32_t led_set_state(uint32_t index)
{
     if (index >= NUM_LEDS) {
        LOG_ERR("Index %u out of bounds (max: %u)", index, NUM_LEDS - 1);
        return -EINVAL;
    }

    return gpio_pin_set_dt(&leds[index], true);
}

/**
 * @brief Set all LEDs simultaneously.
 */
void leds_set_all(void)
{
    for (size_t i = 0; i < NUM_LEDS; i++) {
        gpio_pin_set_dt(&leds[i], true);
    }
}

/**
 * @brief Reset a specific LED by array index.
 */
uint32_t led_reset_state(uint32_t index)
{
     if (index >= NUM_LEDS) {
        LOG_ERR("Index %u out of bounds (max: %u)", index, NUM_LEDS - 1);
        return -EINVAL;
    }

    return gpio_pin_set_dt(&leds[index], false);
}

/**
 * @brief Reset all LEDs simultaneously.
 */
void leds_reset_all(void)
{
    for (size_t i = 0; i < NUM_LEDS; i++) {
        gpio_pin_set_dt(&leds[i], false);
    }
}

/**
 * @brief Toggle a specific LED by array index.
 */
uint32_t led_toggle(uint32_t index)
{
    if (index >= NUM_LEDS) {
        LOG_ERR("Index %u out of bounds (max: %u)", index, NUM_LEDS - 1);
        return -EINVAL;
    }

    return gpio_pin_toggle_dt(&leds[index]);
}

/**
 * @brief Toggle all LEDs simultaneously.
 */
void leds_toggle_all(void)
{
    for (size_t i = 0; i < NUM_LEDS; i++) {
        gpio_pin_toggle_dt(&leds[i]);
    }
}
```
